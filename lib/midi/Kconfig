## lib/midi/Kconfig
```kconfig
# SPDX-License-Identifier: MIT

config MIDI
	bool "Minimal SMF MIDI parser and polyphonic DDS synthesizer"
	help
	  Enable the in-tree MIDI library. Parses Standard MIDI Files (Format 0
	  and 1) from a raw byte array and synthesizes polyphonic sine-wave audio
	  as int16_t PCM with no dynamic memory allocation. Requires math.h
	  (sinf, powf) — enable CONFIG_FPU for hardware acceleration.
```

## lib/ptttl/Kconfig
```kconfig
# SPDX-License-Identifier: MIT

config PTTTL
	bool "PTTTL/RTTTL ringtone parser and sample generator"
	help
	  Enable the eriknyquist/ptttl library (MIT). Parses RTTTL/PTTTL ringtone
	  strings and generates int16_t PCM audio samples with no dynamic memory
	  allocation. Requires only string.h (memset) and stdint.h.
```

## west.yml
```yaml
# Copyright (c) 2021 Nordic Semiconductor ASA
# SPDX-License-Identifier: Apache-2.0

manifest:
  self:
    west-commands: scripts/west-commands.yml

  remotes:
    - name: zephyrproject-rtos
      url-base: https://github.com/zephyrproject-rtos
    - name: eve-zephyr
      url-base: https://github.com/everedero

  projects:
    - name: zephyr
      remote: eve-zephyr
      revision: 9e8c58f5d5866
      import:
        # By using name-allowlist we can clone only the modules that are
        # strictly needed by the application.
        name-allowlist:
          - cmsis      # required by the ARM port
          - cmsis_6    # required by Zephyr 4.4 for Cortex-M CMSIS headers
          - hal_atmel  # required by Arduino Due (SAM3X8E)
          - hal_stm32  # required by the nucleo_f756zg board (STM32 based)
```
